## Kconfig
```kconfig
menu "secure-subsystem"

    config MCUX_COMPONENT_middleware.secure-subsystem
        bool "Secure Subsystem"
        select MCUX_COMPONENT_middleware.secure-subsystem.mu
        select MCUX_COMPONENT_middleware.secure-subsystem.elemu

    config MCUX_COMPONENT_middleware.secure-subsystem.mu
        bool "Secure Subsystem MU"
        select MCUX_COMPONENT_middleware.secure-subsystem.elemu

    config MCUX_COMPONENT_middleware.secure-subsystem.elemu
        bool "Secure Subsystem ELE MU"
        select MCUX_COMPONENT_driver.elemu

    config MCUX_COMPONENT_middleware.secure-subsystem.firmware
        bool "Secure Subsystem Firmware"
        select MCUX_COMPONENT_middleware.secure-subsystem
        select MCUX_COMPONENT_driver.elemu

    config MCUX_COMPONENT_middleware.secure-subsystem.elemu.port_kw45_k4w1
        bool "ELE MU Port KW45/K4W1"
        select MCUX_COMPONENT_middleware.secure-subsystem

    config MCUX_COMPONENT_middleware.secure-subsystem.elemu.crypto_sss_interface
        bool "ELE MU Crypto SSS Interface"
        select MCUX_COMPONENT_middleware.secure-subsystem

endmenu
```
